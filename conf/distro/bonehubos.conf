## conf/distro/bonehubos.conf
```bitbake
# Inherit from poky as a base
require conf/distro/poky.conf

DISTRO = "bonehubos"
DISTRO_NAME = "bonehubOS"
DISTRO_VERSION = "1.0.0"
DISTRO_CODENAME = "bonehubos"

DISTRO_FEATURES:append = " systemd"
DISTRO_FEATURES:remove = "sysvinit"
INIT_MANAGER = "systemd"
VIRTUAL-RUNTIME_init_manager = "systemd"
VIRTUAL-RUNTIME_login_manager = "systemd"

# Enable systemd networkd
PACKAGECONFIG:append:pn-systemd = " networkd resolved"
```

## conf/machine/beaglebone-yocto.conf
```bitbake
# BBB machine configuration
MACHINE = "beaglebone-yocto"

# Debug: Add a unique variable to verify this file is loaded
BONEHUB_DEBUG = "Machine configuration loaded successfully!"

# Force override with highest priority
SERIAL_CONSOLES:forcevariable = "115200;ttyS0"
SERIAL_CONSOLES:append = ""
SERIAL_CONSOLES:remove = "115200;ttyO0 115200;ttyAMA0"

USE_VT = "0"
SYSVINIT_ENABLED_GETTYS = ""

# Fix kernel image naming
KERNEL_IMAGETYPE = "zImage"
KERNEL_IMAGE_BASE_NAME = "zImage"
# Debug: Print when this file is loaded
python () {
    bb.warn("BONEHUB DEBUG: beaglebone-yocto.conf loaded!")
    bb.warn("BONEHUB DEBUG: SERIAL_CONSOLES = " + d.getVar('SERIAL_CONSOLES'))
}
```
